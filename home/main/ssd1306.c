#include "ssd1306.h"

// 显存缓冲区：128列 × 8页
static uint8_t buffer[SSD1306_WIDTH * SSD1306_PAGES];

// ASCII 6x8 字模
const uint8_t font6x8[][6] = {
    {0x00, 0x00, 0x00, 0x00, 0x00, 0x00}, //   0
    {0x00, 0x00, 0x00, 0x2F, 0x00, 0x00}, // ! 1
    {0x00, 0x00, 0x07, 0x00, 0x07, 0x00}, // " 2
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    {0x00, 0x08, 0x04, 0x08, 0x10, 0x08}, // ~ 94
};

/*宽8像素，高16像素*/
const uint8_t font8x16[][16] =
{
	{0x00,0x00,0x00,0x00,0x00,0x00,0x00,0x00,
	0x00,0x00,0x00,0x00,0x00,0x00,0x00,0x00},//   0
	{0x00,0x00,0x00,0xF8,0x00,0x00,0x00,0x00,
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	0x00,0x00,0x00,0x00,0x00,0x01,0x01,0x00},// ~ 94
};

// 初始化 I2C（仅执行一次）
static void i2c_master_init()
{
    static bool initialized = false;
    if (initialized)
        return;
    initialized = true;

    i2c_config_t conf = {
        .mode = I2C_MODE_MASTER,
        .sda_io_num = I2C_SDA_PIN,
        .scl_io_num = I2C_SCL_PIN,
        .sda_pullup_en = GPIO_PULLUP_ENABLE,
        .scl_pullup_en = GPIO_PULLUP_ENABLE,
        .master.clk_speed = I2C_FREQ_HZ,
    };
    ESP_ERROR_CHECK(i2c_param_config(I2C_PORT, &conf));
    ESP_ERROR_CHECK(i2c_driver_install(I2C_PORT, I2C_MODE_MASTER, 0, 0, 0));
}

// 向 OLED 发送单字节命令
static void ssd1306_write_cmd(uint8_t cmd)
{
    i2c_cmd_handle_t cmd_handle = i2c_cmd_link_create();
    i2c_master_start(cmd_handle);
    i2c_master_write_byte(cmd_handle, (SSD1306_I2C_ADDR << 1) | I2C_MASTER_WRITE, true);
    i2c_master_write_byte(cmd_handle, 0x00, true); // 控制字：命令
    i2c_master_write_byte(cmd_handle, cmd, true);  // 写命令
    i2c_master_stop(cmd_handle);
    i2c_master_cmd_begin(I2C_PORT, cmd_handle, pdMS_TO_TICKS(100));
    i2c_cmd_link_delete(cmd_handle);
}

// 向 OLED 批量发送数据（0x40 开头）
static void ssd1306_write_data(uint8_t *data, size_t len)
{
    i2c_cmd_handle_t cmd_handle = i2c_cmd_link_create();
    i2c_master_start(cmd_handle);
    i2c_master_write_byte(cmd_handle, (SSD1306_I2C_ADDR << 1) | I2C_MASTER_WRITE, true);
    i2c_master_write_byte(cmd_handle, 0x40, true); // 控制字：数据
    i2c_master_write(cmd_handle, data, len, true); // 写数据
    i2c_master_stop(cmd_handle);
    i2c_master_cmd_begin(I2C_PORT, cmd_handle, pdMS_TO_TICKS(100));
    i2c_cmd_link_delete(cmd_handle);
}

// OLED 初始化（根据 SSD1306 datasheet 设置）
void ssd1306_init()
{
    i2c_master_init();

    vTaskDelay(pdMS_TO_TICKS(100)); // 等待上电稳定

    // 发送初始化命令序列
    ssd1306_write_cmd(0xAE); // 关闭显示
    ssd1306_write_cmd(0x20);
    ssd1306_write_cmd(0x00); // 设置地址模式：水平模式
    ssd1306_write_cmd(0xB0); // 设置页起始地址
    ssd1306_write_cmd(0xC8); // COM扫描方向：从上到下
    ssd1306_write_cmd(0x00); // 设置低列地址
    ssd1306_write_cmd(0x10); // 设置高列地址
    ssd1306_write_cmd(0x40); // 设置起始行地址
    ssd1306_write_cmd(0x81);
    ssd1306_write_cmd(0x7F); // 设置对比度
    ssd1306_write_cmd(0xA1); // 段重映射：从左到右
    ssd1306_write_cmd(0xA6); // 正常显示（不反白）
    ssd1306_write_cmd(0xA8);
    ssd1306_write_cmd(0x3F); // 设置多路复用比（1/64）
    ssd1306_write_cmd(0xA4); // 显示跟随 RAM
    ssd1306_write_cmd(0xD3);
    ssd1306_write_cmd(0x00); // 设置显示偏移
    ssd1306_write_cmd(0xD5);
    ssd1306_write_cmd(0x80); // 设置显示时钟分频
    ssd1306_write_cmd(0xD9);
    ssd1306_write_cmd(0xF1); // 设置预充电周期
    ssd1306_write_cmd(0xDA);
    ssd1306_write_cmd(0x12); // 设置 COM 引脚硬件配置
    ssd1306_write_cmd(0xDB);
    ssd1306_write_cmd(0x40); // 设置 VCOMH 电压倍率
    ssd1306_write_cmd(0x8D);
    ssd1306_write_cmd(0x14); // 使能 charge pump
    ssd1306_write_cmd(0xAF); // 开启显示

    ssd1306_clear(); // 清空屏幕
}

// 清空屏幕缓冲区 + 刷新显示
void ssd1306_clear()
{
    memset(buffer, 0x00, sizeof(buffer)); // 清零缓冲区
    ssd1306_refresh();                    // 刷新到屏幕
}

// 将缓冲区内容刷新到 OLED
void ssd1306_refresh()
{
    for (uint8_t page = 0; page < SSD1306_PAGES; page++)
    {
        ssd1306_write_cmd(0xB0 + page); // 设置页地址
        ssd1306_write_cmd(0x00);        // 设置低列地址
        ssd1306_write_cmd(0x10);        // 设置高列地址

        // 每页 128 列数据
        ssd1306_write_data(&buffer[page * SSD1306_WIDTH], SSD1306_WIDTH);
    }
}

// 绘制一个 6x8 字符到指定位置（页 = 行 / 8）
void ssd1306_draw_char(uint8_t x, uint8_t page, char c)
{
    if (c < 32 || c > 127)
        return; // 非法字符
    for (int i = 0; i < 6; i++)
    {
        buffer[page * SSD1306_WIDTH + x + i] = font6x8[c - 32][i];
    }
}

// 绘制一个 8x16 字符（占用两页）
void ssd1306_draw_char8x16(uint8_t x, uint8_t page, char c)
{
    if (c < 32 || c > 127 || x > SSD1306_WIDTH - 8 || page > SSD1306_PAGES - 2)
        return;

    uint8_t index = c - 32;

    for (int i = 0; i < 8; i++)
    {
        buffer[page * SSD1306_WIDTH + x + i] = font8x16[index][i];           // 上半部分
        buffer[(page + 1) * SSD1306_WIDTH + x + i] = font8x16[index][i + 8]; // 下半部分
    }
}

// 绘制字符串，自动移动横坐标
void ssd1306_draw_string(uint8_t x, uint8_t page, const char *str)
{
    while (*str && x < SSD1306_WIDTH - 6)
    {
        ssd1306_draw_char(x, page, *str++);
        x += 6; // 每个字符6像素
    }
}

void ssd1306_draw_string8x16(uint8_t x, uint8_t page, const char *str)
{
    while (*str && x < SSD1306_WIDTH - 8)
    {
        ssd1306_draw_char8x16(x, page, *str++);
        x += 8; // 每个字符宽8像素
    }
}


void show_task(void *pvParameters)
{
    while (1)
    {
        ssd1306_refresh(); // 刷新显示

        vTaskDelay(pdMS_TO_TICKS(200)); // 每 200 秒更新一次
    }
}